## boards/shields/oluka56/Kconfig.defconfig
```kconfig
if SHIELD_OLUKA56_LEFT

# Name must be less than 16 characters long!
config ZMK_KEYBOARD_NAME
    default "OLuka56"

config ZMK_SPLIT_ROLE_CENTRAL
    default y

endif

if SHIELD_OLUKA56_LEFT || SHIELD_OLUKA56_RIGHT

config ZMK_SPLIT
    default y

endif
```
